## main/Kconfig.projbuild
```kconfig
menu "KernSigner Configuration"

    choice KSIG_BOARD
        prompt "Target board"
        default KSIG_BOARD_WAVE_4B
        help
            Select the Waveshare ESP32-P4 board variant.

        config KSIG_BOARD_WAVE_4B
            bool "Waveshare ESP32-P4-WiFi6-Touch-LCD-4B (720x720)"

        config KSIG_BOARD_WAVE_35
            bool "Waveshare ESP32-P4-WiFi6-Touch-LCD-3.5 (320x480)"

        config KSIG_BOARD_WAVE_5
            bool "Waveshare ESP32-P4-WiFi6-Touch-LCD-5 (720x1280 MIPI DSI)"

        config KSIG_BOARD_WAVE_43
            bool "Waveshare ESP32-P4-WiFi6-Touch-LCD-4.3 (480x800 MIPI DSI)"
    endchoice

    config KSIG_PRODUCTION_REQUIRE_PIN_HMAC
        bool "Production: require eFuse HMAC key for PIN salt"
        default n
        help
            Development builds may fall back to a deterministic PIN salt so a
            fresh board can be tested before eFuse provisioning. Commercial
            real-funds builds must enable this option so PIN setup/verification
            fails unless eFuse KEY5 is provisioned for the HMAC peripheral.

    config KSIG_PN5180_ENABLED
        bool "Enable PN5180 NFC smartcard reader"
        default y if KSIG_BOARD_WAVE_43
        default n
        help
            Enable the PN5180 SPI NFC reader transport for ISO14443A
            CPU smartcards.

    config KSIG_PN5180_SPI_HZ
        int "PN5180 SPI clock Hz"
        default 1000000
        range 100000 5000000
        depends on KSIG_PN5180_ENABLED
        help
            SPI clock used for the PN5180 NFC module. The tested module is
            reliable at 1 MHz with short jumper wires.

    config KSIG_PN5180_PIN_SCK
        int "PN5180 SCK GPIO"
        default 52 if KSIG_BOARD_WAVE_43
        default -1
        depends on KSIG_PN5180_ENABLED

    config KSIG_PN5180_PIN_MOSI
        int "PN5180 MOSI GPIO"
        default 51 if KSIG_BOARD_WAVE_43
        default -1
        depends on KSIG_PN5180_ENABLED

    config KSIG_PN5180_PIN_MISO
        int "PN5180 MISO GPIO"
        default 50 if KSIG_BOARD_WAVE_43
        default -1
        depends on KSIG_PN5180_ENABLED

    config KSIG_PN5180_PIN_NSS
        int "PN5180 NSS/CS GPIO"
        default 49 if KSIG_BOARD_WAVE_43
        default -1
        depends on KSIG_PN5180_ENABLED

    config KSIG_PN5180_PIN_BUSY
        int "PN5180 BUSY GPIO"
        default 31 if KSIG_BOARD_WAVE_43
        default -1
        depends on KSIG_PN5180_ENABLED

    config KSIG_PN5180_PIN_RST
        int "PN5180 RST GPIO"
        default 30 if KSIG_BOARD_WAVE_43
        default -1
        depends on KSIG_PN5180_ENABLED

    config KSIG_PN5180_PIN_IRQ
        int "PN5180 IRQ GPIO"
        default -1
        depends on KSIG_PN5180_ENABLED
        help
            Optional PN5180 IRQ GPIO. Use -1 when IRQ is not connected.

endmenu
```

## nfc_bringup/main/Kconfig.projbuild
```kconfig
menu "KernSigner NFC Bring-up"

    config NFC_BRINGUP_I2C_PORT
        int "PN532 I2C port"
        default -1

    config NFC_BRINGUP_PIN_SDA
        int "PN532 SDA GPIO"
        default -1

    config NFC_BRINGUP_PIN_SCL
        int "PN532 SCL GPIO"
        default -1

    config NFC_BRINGUP_I2C_HZ
        int "PN532 I2C clock Hz"
        default 100000

endmenu
```

## nfc_bringup/sdkconfig.defaults
```kconfig
CONFIG_IDF_TARGET="esp32p4"
CONFIG_ESP32P4_SELECTS_REV_LESS_V3=y
CONFIG_ESP32P4_REV_MIN_100=y
CONFIG_NFC_BRINGUP_I2C_PORT=-1
CONFIG_NFC_BRINGUP_PIN_SDA=28
CONFIG_NFC_BRINGUP_PIN_SCL=31
CONFIG_NFC_BRINGUP_I2C_HZ=100000
```

## pn5180_bringup/main/Kconfig.projbuild
```kconfig
menu "KernSigner PN5180 Bring-up"

    config PN5180_BRINGUP_PIN_SCK
        int "PN5180 SCK GPIO"
        default 52

    config PN5180_BRINGUP_PIN_MOSI
        int "PN5180 MOSI GPIO"
        default 51

    config PN5180_BRINGUP_PIN_MISO
        int "PN5180 MISO GPIO"
        default 50

    config PN5180_BRINGUP_PIN_NSS
        int "PN5180 NSS/CS GPIO"
        default 49

    config PN5180_BRINGUP_PIN_BUSY
        int "PN5180 BUSY GPIO"
        default 31

    config PN5180_BRINGUP_PIN_RST
        int "PN5180 RST/NRESET GPIO"
        default 30

    config PN5180_BRINGUP_PIN_IRQ
        int "PN5180 IRQ GPIO, -1 to skip"
        default -1

    config PN5180_BRINGUP_SPI_HZ
        int "PN5180 SPI clock Hz"
        default 1000000

endmenu
```

## pn5180_bringup/sdkconfig.defaults
```kconfig
CONFIG_IDF_TARGET="esp32p4"
CONFIG_ESP32P4_SELECTS_REV_LESS_V3=y
CONFIG_ESP32P4_REV_MIN_100=y
CONFIG_PN5180_BRINGUP_PIN_SCK=52
CONFIG_PN5180_BRINGUP_PIN_MOSI=51
CONFIG_PN5180_BRINGUP_PIN_MISO=50
CONFIG_PN5180_BRINGUP_PIN_NSS=49
CONFIG_PN5180_BRINGUP_PIN_BUSY=31
CONFIG_PN5180_BRINGUP_PIN_RST=30
CONFIG_PN5180_BRINGUP_PIN_IRQ=-1
CONFIG_PN5180_BRINGUP_SPI_HZ=1000000
```

## sdkconfig.defaults.high_value
```kconfig
# KernSigner high-value custody target overlay.
#
# This file is a target, not proof of production readiness. Build with it only
# after testing the eFuse workflow on a sacrificial board:
#
# idf.py -B build_high_value_wave_43 \
#   -D SDKCONFIG=build_high_value_wave_43/sdkconfig \
#   -D 'SDKCONFIG_DEFAULTS=sdkconfig.defaults;sdkconfig.defaults.wave_43;sdkconfig.defaults.high_value' \
#   build

CONFIG_KSIG_PRODUCTION_REQUIRE_PIN_HMAC=y

# Firmware integrity and flash-at-rest protection.
CONFIG_SECURE_BOOT=y
CONFIG_SECURE_BOOT_V2_PREFERRED=y
CONFIG_SECURE_BOOT_V2_ECC_SUPPORTED=y
CONFIG_SECURE_BOOT_BUILD_SIGNED_BINARIES=y
CONFIG_SECURE_FLASH_ENC_ENABLED=y
CONFIG_NVS_ENCRYPTION=y

# Secure Boot signatures make the ESP32-P4 bootloader larger than the default
# 0x8000 partition-table offset allows.
CONFIG_PARTITION_TABLE_CUSTOM_FILENAME="partitions.high_value.csv"
CONFIG_PARTITION_TABLE_FILENAME="partitions.high_value.csv"
CONFIG_PARTITION_TABLE_OFFSET=0x10000

# No radios/network stack in the high-value target.
# CONFIG_BT_ENABLED is not set
# CONFIG_ESP_HOST_WIFI_ENABLED is not set
# CONFIG_ESP_WIFI_ENABLED is not set
# CONFIG_ETH_ENABLED is not set
# CONFIG_ETH_USE_ESP32_EMAC is not set
# CONFIG_ETH_USE_SPI_ETHERNET is not set
# CONFIG_ETH_USE_OPENETH is not set
# CONFIG_LWIP_ENABLE is not set

# No production console/debugger paths.
# CONFIG_USJ_ENABLE_USB_SERIAL_JTAG is not set
# CONFIG_ESP_GDBSTUB_ENABLED is not set
# CONFIG_ESP_SYSTEM_PANIC_GDBSTUB is not set
CONFIG_ESP_SYSTEM_PANIC_SILENT_REBOOT=y
CONFIG_ESP_CONSOLE_NONE=y
# CONFIG_ESP_CONSOLE_UART_DEFAULT is not set
# CONFIG_ESP_CONSOLE_UART_CUSTOM is not set
# CONFIG_ESP_CONSOLE_UART is not set
# CONFIG_ESP_CONSOLE_USB_SERIAL_JTAG is not set
CONFIG_ESP_CONSOLE_SECONDARY_NONE=y
# CONFIG_ESP_CONSOLE_USB_SERIAL_JTAG_ENABLED is not set
# CONFIG_ESP_CONSOLE_SECONDARY_USB_SERIAL_JTAG is not set

# Fail closed on task stalls.
CONFIG_ESP_TASK_WDT_EN=y
CONFIG_ESP_TASK_WDT_INIT=y
CONFIG_ESP_TASK_WDT_PANIC=y
```

## sdkconfig.defaults.wave_43
```kconfig
# Board: Waveshare ESP32-P4-WiFi6-Touch-LCD-4.3 (480x800 MIPI DSI)
CONFIG_KSIG_BOARD_WAVE_43=y
CONFIG_KSIG_PN5180_ENABLED=y
CONFIG_KSIG_PN5180_SPI_HZ=1000000
CONFIG_KSIG_PN5180_PIN_SCK=52
CONFIG_KSIG_PN5180_PIN_MOSI=51
CONFIG_KSIG_PN5180_PIN_MISO=50
CONFIG_KSIG_PN5180_PIN_NSS=49
CONFIG_KSIG_PN5180_PIN_BUSY=31
CONFIG_KSIG_PN5180_PIN_RST=30
CONFIG_KSIG_PN5180_PIN_IRQ=-1
CONFIG_LV_FONT_MONTSERRAT_16=y
CONFIG_LV_USE_FONT_COMPRESSED=y
CONFIG_ESPTOOLPY_FLASHMODE_QIO=y
```
